/ {
    leds {
      compatible = "gpio-leds";
      user_led: led0 { 
        gpios = <&gpio1 8 (1 << 0)>; 
        label = "Green LED";
      };
    };

    aliases {
      led0 = &user_led;
    };
};
